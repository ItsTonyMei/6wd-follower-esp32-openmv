#include "oled.h"

// ═══ 引脚宏 (同 PS2 风格寄存器访问) ═══
#define OLED_RST_H GPIOB->BSRR = (1 << 3)
#define OLED_RST_L GPIOB->BRR  = (1 << 3)
#define OLED_DC_H  GPIOA->BSRR = (1 << 15)
#define OLED_DC_L  GPIOA->BRR  = (1 << 15)
#define OLED_CLK_H GPIOB->BSRR = (1 << 5)
#define OLED_CLK_L GPIOB->BRR  = (1 << 5)
#define OLED_DIN_H GPIOB->BSRR = (1 << 4)
#define OLED_DIN_L GPIOB->BRR  = (1 << 4)

// ═══ 帧缓冲 (1024 bytes) ═══
static uint8_t gram[128][8];

// ═══ 6x12 字体 (ASCII 32-126) ═══
static const uint8_t font6x12[][12] = {
    {0x00,0x00,0x00,0x00,0x00,0x00,0x00,0x00,0x00,0x00,0x00,0x00}, // space
    {0x00,0x00,0x00,0xF8,0x00,0x00,0x00,0x00,0x00,0x00,0x00,0x00}, // !
    {0x00,0x00,0x70,0x00,0x70,0x00,0x00,0x00,0x00,0x00,0x00,0x00}, // "
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    {0x00,0x40,0x80,0x40,0x20,0x40,0x00,0x00,0x00,0x00,0x00,0x00}, // ~
};

// ═══ 写字节 (MSB first, 软件SPI) ═══
static void oledWriteByte(uint8_t dat, uint8_t dc) {
    if (dc) OLED_DC_H; else OLED_DC_L;
    for (uint8_t i = 0; i < 8; i++) {
        OLED_CLK_L;
        if (dat & 0x80) OLED_DIN_H; else OLED_DIN_L;
        OLED_CLK_H;
        dat <<= 1;
    }
    OLED_DC_H;
}

// ═══ 写命令 ═══
static void oledCmd(uint8_t cmd) { oledWriteByte(cmd, 0); }

// ═══ 设置页地址和列地址 ═══
static void oledSetPos(uint8_t x, uint8_t y) {
    oledCmd(0xB0 + y);
    oledCmd(((x & 0xF0) >> 4) | 0x10);
    oledCmd(x & 0x0F);
}

// ═══ 初始化 ═══
void oledInit() {
    RCC->APB2ENR |= RCC_APB2ENR_IOPAEN | RCC_APB2ENR_IOPBEN | RCC_APB2ENR_AFIOEN;
    // 禁用 JTAG, 释放 PA15 作为 GPIO
    AFIO->MAPR = (AFIO->MAPR & ~AFIO_MAPR_SWJ_CFG) | AFIO_MAPR_SWJ_CFG_2;

    // PA15=DC, PB3=RST, PB4=DIN, PB5=CLK: 推挽输出 50MHz
    GPIOA->CRH &= ~(0xF << 28);
    GPIOA->CRH |=  (0x3 << 28);
    GPIOB->CRL &= ~(0xF << 12 | 0xF << 16 | 0xF << 20);
    GPIOB->CRL |=  (0x3 << 12 | 0x3 << 16 | 0x3 << 20);

    OLED_RST_L; delay(100);
    OLED_RST_H; delay(100);

    oledCmd(0xAE); // display off
    oledCmd(0xD5); oledCmd(0x50); // osc freq
    oledCmd(0xA8); oledCmd(0x3F); // mux ratio
    oledCmd(0xD3); oledCmd(0x00); // display offset
    oledCmd(0x40);   // start line
    oledCmd(0x8D); oledCmd(0x14); // charge pump
    oledCmd(0x20); oledCmd(0x02); // page addressing
    oledCmd(0xA1);   // seg remap (WHEELTEC 原值)
    oledCmd(0xC8);   // COM scan dir (垂直翻转)
    oledCmd(0xDA); oledCmd(0x12); // COM pins
    oledCmd(0x81); oledCmd(0xEF); // contrast
    oledCmd(0xD9); oledCmd(0xF1); // pre-charge
    oledCmd(0xDB); oledCmd(0x30); // VCOMH
    oledCmd(0xA4);   // display on (follow RAM)
    oledCmd(0xA6);   // normal (not inverse)
    oledCmd(0xAF);   // display on

    oledClear();
    oledRefresh();
}

// ═══ 清屏 ═══
void oledClear() { memset(gram, 0, sizeof(gram)); }

// ═══ 画点 ═══
static void oledDrawPoint(uint8_t x, uint8_t y, uint8_t t) {
    if (x > 127 || y > 63) return;
    if (t) gram[x][y / 8] |= (1 << (y % 8));
    else   gram[x][y / 8] &= ~(1 << (y % 8));
}

// ═══ 6x12 字符 ═══
static void oledShowChar(uint8_t x, uint8_t y, uint8_t chr) {
    if (chr < 32 || chr > 126) chr = 32;
    chr -= 32;
    for (uint8_t i = 0; i < 6; i++) {
        uint8_t d = font6x12[chr][i];
        for (uint8_t j = 0; j < 8; j++) {
            oledDrawPoint(x + i, y + j, d & (1 << (7 - j)));
        }
    }
    // 下半部分
    for (uint8_t i = 0; i < 6; i++) {
        uint8_t d = font6x12[chr][i + 6];
        for (uint8_t j = 0; j < 4; j++) {
            oledDrawPoint(x + i, y + 8 + j, d & (1 << (7 - j)));
        }
    }
}

// ═══ 字符串 (12px, 自动换行) ═══
void oledShowString(uint8_t x, uint8_t y, const char* str) {
    while (*str) {
        if (x > 122) { x = 0; y += 12; }
        if (y > 52) { oledClear(); x = 0; y = 0; }
        oledShowChar(x, y, *str++);
        x += 6;
    }
}

// ═══ 数字 (size=12) ═══
void oledShowNumber(uint8_t x, uint8_t y, uint32_t num, uint8_t len, uint8_t size) {
    char buf[11];
    for (int i = len - 1; i >= 0; i--) { buf[i] = '0' + (num % 10); num /= 10; }
    buf[len] = '\0';
    oledShowString(x, y, buf);
}

// ═══ 刷新 ═══
void oledRefresh() {
    for (uint8_t page = 0; page < 8; page++) {
        oledSetPos(0, page);
        for (uint8_t col = 0; col < 128; col++) oledWriteByte(gram[col][page], 1);
    }
}
